## sdkconfig.defaults
```kconfig
# HTTP Server: 增大请求头缓冲区以适应手机浏览器
CONFIG_HTTPD_MAX_REQ_HDR_LEN=2048

# LWIP: 增大 socket 数量（HTTP server 内部占用 3 个，max_open_sockets 不能超过 LWIP_MAX_SOCKETS-3）
CONFIG_LWIP_MAX_SOCKETS=16

# TLS: 跳过服务器证书验证（腾讯云反向代理）
CONFIG_ESP_TLS_INSECURE=y
CONFIG_ESP_TLS_SKIP_SERVER_CERT_VERIFY=y

# Flash: 16MB
CONFIG_ESPTOOLPY_FLASHSIZE_16MB=y
CONFIG_ESPTOOLPY_FLASHSIZE="16MB"
```
